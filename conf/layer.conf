## conf/layer.conf
```bitbake
# We have a conf and classes directory, add to BBPATH
BBPATH .= ":${LAYERDIR}"

# We have a packages directory, add to BBFILES
BSP_NXP_DERIVED ??= ""
BBFILES += "${@bb.utils.contains_any('MACHINE', '${BSP_NXP_DERIVED}', '${LAYERDIR}/recipes-*/*/*.bb', '', d)}"
BBFILES += "${@bb.utils.contains_any('MACHINE', '${BSP_NXP_DERIVED}', '${LAYERDIR}/recipes-*/*/*.bbappend', '', d)}"

RECIPE_LIST_REASON:fsl-bsp-release = "You are about to enable third-party components, there is additional third-part licensing involved, and you might need to consult with your legal department."

BBFILE_COLLECTIONS += "meta-freescale-ml"
BBFILE_PATTERN_meta-freescale-ml := "^${LAYERDIR}/"
BBFILE_PRIORITY_meta-freescale-ml = "5"
LAYERSERIES_COMPAT_meta-freescale-ml = "mickledore nanbield scarthgap styhead walnascar whinlatter wrynose"
LAYERDEPENDS_meta-freescale-ml = "freescale-layer meta-python"
```
